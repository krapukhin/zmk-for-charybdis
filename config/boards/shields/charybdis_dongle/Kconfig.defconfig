## zmk-pmw3610-driver-main/Kconfig
```kconfig
# Sensor data simulator
#
# Copyright (c) 2019 Nordic Semiconductor
#
# SPDX-License-Identifier: LicenseRef-Nordic-5-Clause
#

menuconfig PMW3610
    bool "PMW3610 mouse optical sensor"
  select SPI
    help
      Enable PMW3610 mouse optical sensor.

if PMW3610

config PMW3610_SMART_ALGORITHM
  bool "Enable an algorithm of PMW3610 to enhance surface coverage"
  default y
  help
    Enable the integration of the smart algorithm as the datasheet implementation.
    The algorithm is used to extend the tracking acrocss a wider range of surfaces
    such as graniles and tiles.

config PMW3610_CPI
    int "PMW3610's default CPI"
    default 800
    range 200 3200
    help
      Default CPI value, with 200 step

config PMW3610_CPI_DIVIDOR
    int "PMW3610's default CPI dividor"
    default 1
    range 1 100
    help
      Default CPI dividor value.

config PMW3610_SNIPE_CPI
    int "PMW3610's CPI in snipe mode"
    default 200
    range 200 3200
    help
      Snipe CPI value, with 200 step

config PMW3610_SNIPE_CPI_DIVIDOR
    int "PMW3610's CPI dividor in snipe mode"
    default 1
    range 1 100
    help
      Snipe CPI dividor value.

config PMW3610_SCROLL_TICK
    int "PMW3610's required ticks to produce a scroll report"
    default 20
    range 1 1000
    help
      Scroll tick value. Higher = slower scrolling.
      Must be >= 1: the scroll accumulator divides by this value.

config PMW3610_CARET_TICK
    int "PMW3610's required ticks to produce an arrow key press in caret mode"
    default 20
    range 1 1000
    help
      Caret tick value. Controls sensitivity of trackball-to-arrow-key conversion.
      Higher value = less sensitive (more trackball movement needed per arrow key press).

choice
    prompt "Select PMW3610's polling rate"
    default PMW3610_POLLING_RATE_250

config PMW3610_POLLING_RATE_250
    bool "250 Hz"

config PMW3610_POLLING_RATE_125
    bool "125 Hz"

config PMW3610_POLLING_RATE_125_SW
    bool "125 Hz with software implementation"

endchoice

config PMW3610_FORCE_AWAKE
    bool "PMW3610 forced awake mode"
    help
      This setting forces the sensor to always be in the RUN state.

config PMW3610_RUN_DOWNSHIFT_TIME_MS
    int "PMW3610's default RUN mode downshift time"
    default 128
    range 13 3264
    help
      Default RUN mode downshift down time in milliseconds.
      Time after which sensor goes from RUN to REST1 mode.

config PMW3610_REST1_SAMPLE_TIME_MS
    int "PMW3610's sample time in REST1 stage"
    default 40
    range 10 2550
    help
      Default REST1 mode sample period in millisecond

config PMW3610_REST1_DOWNSHIFT_TIME_MS
    int "PMW3610's default REST1 mode downshift time"
    default 9600
    help
      Default REST1 mode downshift down time in milliseconds.
      Time after which sensor goes from REST1 to REST2 mode.

config PMW3610_REST2_SAMPLE_TIME_MS
    int "PMW3610's sample time in REST2 stage"
    default 0
    range 0 2550
    help
      Default REST2 mode sample period in millisecond.
      Minimum value is 10.
      No optimal value provided by datasheet.

config PMW3610_REST2_DOWNSHIFT_TIME_MS
    int "PMW3610's default REST2 mode downshift time"
    default 0
    help
      Default REST2 mode downshift down time in milliseconds.
      Time after which sensor goes from REST2 to REST3 mode.
      No optimal value provided by datasheet.

config PMW3610_REST3_SAMPLE_TIME_MS
    int "PMW3610's sample time in REST3 stage"
    default 0
    range 0 2550
    help
      Default REST2 mode sample period in millisecond.
      Minimum value is 10.
      No optimal value provided by datasheet.

choice
    prompt "Select PMW3610 sensor orientation"
    default PMW3610_ORIENTATION_0

config PMW3610_ORIENTATION_0
    bool "PMW3610 not rotated"

config PMW3610_ORIENTATION_90
    bool "PMW3610 rotated 90 deg clockwise"

config PMW3610_ORIENTATION_180
    bool "PMW3610 rotated 180 deg clockwise"

config PMW3610_ORIENTATION_270
    bool "PMW3610 rotated 270 deg clockwise"

endchoice

config PMW3610_INVERT_X
  bool "Invert the X axis of PMW3610 sensor"

config PMW3610_INVERT_Y
  bool "Invert the Y axis of PMW3610 sensor"

config PMW3610_INVERT_SCROLL_X
  bool "Invert the X axis of the scroll"
  default PMW3610_INVERT_X

config PMW3610_INVERT_SCROLL_Y
  bool "Invert the Y axis of the scroll"
  default PMW3610_INVERT_Y

config PMW3610_ACCEL_ENABLED
  bool "Enable pointer acceleration for MOVE mode"
  default n
  help
    Enable plateau-style pointer acceleration. Slow movements are unaffected,
    fast movements are multiplied up to ACCEL_MAX_MULT.

config PMW3610_ACCEL_LOW_SPEED
  int "Speed threshold below which no acceleration is applied (x100)"
  default 300
  depends on PMW3610_ACCEL_ENABLED
  help
    Speeds below this value (in counts/ms * 100) get multiplier 1.0.
    Example: 300 means 3.00 counts/ms.

config PMW3610_ACCEL_HIGH_SPEED
  int "Speed threshold above which max acceleration is applied (x100)"
  default 2000
  depends on PMW3610_ACCEL_ENABLED
  help
    Speeds above this value get the maximum multiplier.
    Example: 2000 means 20.00 counts/ms.

config PMW3610_ACCEL_MAX_MULT
  int "Maximum acceleration multiplier (x100)"
  default 400
  depends on PMW3610_ACCEL_ENABLED
  help
    Maximum multiplier applied at high speed.
    Example: 400 means 4.0x.

choice
  prompt "Pointer acceleration curve"
  default PMW3610_ACCEL_CURVE_QUADRATIC
  depends on PMW3610_ACCEL_ENABLED
  help
    Shape of the ramp between ACCEL_LOW_SPEED and ACCEL_HIGH_SPEED.
    All three reach the same 1.0x at LOW and ACCEL_MAX_MULT at HIGH;
    they differ in what happens in between.

config PMW3610_ACCEL_CURVE_LINEAR
  bool "Linear"
  help
    mult = 1 + t * (max - 1). Constant ramp. Simple, but the multiplier
    starts and stops growing abruptly at the two thresholds.

config PMW3610_ACCEL_CURVE_QUADRATIC
  bool "Quadratic"
  help
    mult = 1 + t^2 * (max - 1). Keeps the multiplier near 1.0 well past
    LOW, so slow and medium movements stay honest, then ramps hard toward
    HIGH. Smooth at LOW, abrupt at HIGH. Best for precise pointing.

config PMW3610_ACCEL_CURVE_SMOOTHSTEP
  bool "Smoothstep (S-curve)"
  help
    mult = 1 + t^2 * (3 - 2t) * (max - 1). Mid-range close to linear but
    smooth at both thresholds — no point where acceleration visibly kicks
    in or hits the ceiling.

endchoice

config PMW3610_AUTOMOUSE_TIMEOUT_MS
  int "Amount of milliseconds the mouse layer will be active after using the trackball"
  default 400

module = PMW3610
module-str = PMW3610
source "${ZEPHYR_BASE}/subsys/logging/Kconfig.template.log_config"

endif #PMW3610

# Caret-процессор живёт в этом же модуле, но с сенсором не связан: он работает
# на том устройстве, которое держит раскладку. В донгл-варианте это донгл,
# в прямом BLE-режиме — правая половина.
config ZMK_INPUT_PROCESSOR_CARET
  bool "Caret mode input processor (pointer movement -> arrow keys)"
  default y
  depends on DT_HAS_ZMK_INPUT_PROCESSOR_CARET_ENABLED
  help
    Converts pointer movement into arrow key presses. Threshold is set per
    instance in devicetree, e.g. <&zip_caret 60>.

# Вывод заряда в USB-лог на уровне INFO. Нужен в донгл-варианте: по USB
# батарею иначе не увидеть, а штатные сообщения ZMK все на LOG_DBG.
config ZMK_BATTERY_LOG
  bool "Log battery levels at INFO level"
  default n
  depends on ZMK_BATTERY_REPORTING
  help
    Prints one line per battery level change, so the level can be read over
    USB CDC without turning on DBG logging for everything else.
```
