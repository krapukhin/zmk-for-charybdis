/*
 * Раскладка донгл-варианта = раскладка основного варианта.
 *
 * Намеренно include, а не копия: иначе два набора прошивок разъехались бы
 * при первой же правке клавиш. Единственный источник правды —
 * config/charybdis.keymap.
 *
 * Файлы для всех трёх донгл-shield'ов заведены явно, потому что ZMK ищет
 * раскладку по имени shield'а, а полагаться на siblings здесь ненадёжно.
 */

#include "charybdis.keymap"
